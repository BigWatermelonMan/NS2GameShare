## firmware-basic/main/Kconfig.projbuild
```kconfig
rsource "../../firmware/main/Kconfig.projbuild"
menu "Basic FX2LP link"
config BASIC_FX2
    bool "Enable parallel IN and FX2 software-UART return link"
    default y
config BASIC_FX2_TRACE
    bool "Temporary bounded UART0 trace between FIFO transactions"
    default n
    help
        Diagnostic only. GPIO1 is restored to DMA before each transfer.
        Disable for gameplay to avoid sending trace bytes to the USB-UART.
config BASIC_FX2_D0
    int "FD0 GPIO"
    default 16
config BASIC_FX2_D1
    int "FD1 GPIO"
    default 17
config BASIC_FX2_D2
    int "FD2 GPIO"
    default 18
config BASIC_FX2_D3
    int "FD3 GPIO"
    default 19
config BASIC_FX2_D4
    int "FD4 GPIO"
    default 23
config BASIC_FX2_D5
    int "FD5 GPIO"
    default 26
config BASIC_FX2_D6
    int "FD6 GPIO"
    default 2
config BASIC_FX2_D7
    int "FD7 GPIO"
    default 1
    help
        GPIO1 is exposed as TX/TXD0 on the Basic base. UART0 application
        transport must be disabled when this pin carries parallel data.
config BASIC_FX2_WR
    int "SLWR GPIO"
    default 5
config BASIC_FX2_SPACE
    int "EP6 not-full flag input GPIO"
    default 35
config BASIC_FX2_RX
    int "FX2 PA0 UART return GPIO"
    default 36
config BASIC_FX2_CLOCK_HZ
    int "Parallel byte clock"
    range 100000 4000000
    default 1000000
endmenu
```

## firmware-basic/sdkconfig.defaults
```kconfig
CONFIG_IDF_TARGET="esp32"
CONFIG_ESP_CONSOLE_NONE=y
CONFIG_BOOTLOADER_LOG_LEVEL_WARN=y
CONFIG_LOG_DEFAULT_LEVEL_WARN=y
CONFIG_ESP_DEFAULT_CPU_FREQ_MHZ_240=y
CONFIG_FREERTOS_HZ=1000
CONFIG_ESP_WIFI_STATIC_RX_BUFFER_NUM=16
CONFIG_ESP_WIFI_DYNAMIC_RX_BUFFER_NUM=48
CONFIG_ESP_WIFI_NVS_ENABLED=n
CONFIG_ESPTOOLPY_FLASHSIZE_16MB=y
CONFIG_PARTITION_TABLE_SINGLE_APP_LARGE=y
CONFIG_SNIFFER_USE_USB_JTAG=n
CONFIG_SNIFFER_USE_UART=n
```

## firmware/main/Kconfig.projbuild
```kconfig
menu "C5 Sniffer"

    config SNIFFER_USE_USB_JTAG
        bool "Accept host on the native USB port (USB-Serial-JTAG)"
        default y
        help
            The board's native USB port (the one wired straight to the chip).
            Fastest link; the baud rate setting on the PC side is ignored.

    config SNIFFER_USE_UART
        bool "Accept host on UART0 (USB-UART bridge port)"
        default y

    config SNIFFER_UART_BAUD
        int "UART0 baud rate"
        depends on SNIFFER_USE_UART
        default 2000000
        help
            Must match --baud on the PC side. 2000000 works with CP210x,
            CH34x and FTDI bridges.

    config SNIFFER_RINGBUF_SIZE
        int "Capture ring buffer size (bytes)"
        default 65536

    config SNIFFER_COUNTRY
        string "Wi-Fi country code (decides which channels may be tuned)"
        default "JP"

    config SNIFFER_DEFAULT_CHANNEL
        int "Channel tuned at boot"
        default 1

endmenu
```
